## drivers/lpm009m360a/Kconfig
```kconfig
# LPM009M360A display driver configuration options

config LPM009M360A
	bool "LPM009M360A display driver"
	default n
	select SPI
	select DISPLAY
	help
		Enable driver for LPM009M360A display driver.
```
